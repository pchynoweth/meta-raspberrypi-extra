## conf/layer.conf
```bitbake
# We have a conf and classes directory, add to BBPATH
BBPATH .= ":${LAYERDIR}"

# We have recipes-* directories, add to BBFILES
BBFILES += "${LAYERDIR}/recipes-*/*/*.bb \
            ${LAYERDIR}/recipes-*/*/*.bbappend"

BBFILE_COLLECTIONS += "meta-raspberrypi-extra"
BBFILE_PATTERN_meta-raspberrypi-extra = "^${LAYERDIR}/"
BBFILE_PRIORITY_meta-raspberrypi-extra = "6"

LAYERDEPENDS_meta-raspberrypi-extra = "core"
LAYERSERIES_COMPAT_meta-raspberrypi-extra = "kirkstone"
```
